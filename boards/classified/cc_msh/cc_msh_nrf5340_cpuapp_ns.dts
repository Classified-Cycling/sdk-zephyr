/*
 * Copyright (c) 2025 Classified Cycling BV
 *
 * SPDX-License-Identifier: Apache-2.0
 */

/dts-v1/;

#include <nordic/nrf5340_cpuappns_qkaa.dtsi>
#include "cc_msh_nrf5340_cpuapp_common.dtsi"

/ {
	model = "Classified Cycling Multispeed Hub nRF5340 Application";
	compatible = "classified,cc-msh-nrf5340-cpuapp";

	chosen {
		zephyr,sram = &sram0_ns_app;
		zephyr,flash = &flash0;
		zephyr,code-partition = &slot0_ns_partition;
	};
};
