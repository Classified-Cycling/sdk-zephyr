## boards/classified/cc_msh/Kconfig
```kconfig
# Copyright (c) 2025 Classified Cycling BV
# SPDX-License-Identifier: Apache-2.0

if BOARD_CC_MSH_NRF5340_CPUAPP || BOARD_CC_MSH_NRF5340_CPUAPP_NS

config DOMAIN_CPUNET_BOARD
	string
	default "cc_msh/nrf5340/cpunet"
	help
	  The board which will be used for CPUNET domain when creating a multi
	  image application where one or more images should be located on
	  another board. For example hci_ipc on the nRF5340_cpunet for
	  Bluetooth applications.

endif # BOARD_CC_MSH_NRF5340_CPUAPP || BOARD_CC_MSH_NRF5340_CPUAPP_NS

config DOMAIN_CPUAPP_BOARD
	string
	default "cc_msh/nrf5340/cpuapp"
	depends on BOARD_CC_MSH_NRF5340_CPUNET
	help
	  The board which will be used for CPUAPP domain when creating a multi
	  image application where one or more images should be located on
	  another board.
```

## boards/classified/cc_msh/Kconfig.cc_msh
```kconfig
# Copyright (c) 2024 Classified Cycling BV
# SPDX-License-Identifier: Apache-2.0

config BOARD_CC_MSH
	select SOC_NRF5340_CPUAPP_QKAA if BOARD_CC_MSH_NRF5340_CPUAPP
	select SOC_NRF5340_CPUAPP_QKAA if BOARD_CC_MSH_NRF5340_CPUAPP_NS
	select SOC_NRF5340_CPUNET_QKAA if BOARD_CC_MSH_NRF5340_CPUNET
```

## boards/classified/cc_msh/board.yml
```yaml
board:
  name: cc_msh
  full_name: Classified Cycling Multispeed Hub
  vendor: classified
  socs:
  - name: 'nrf5340'
    variants:
    - name: 'ns'
      cpucluster: 'cpuapp'
```

## boards/classified/cc_msh/cc_msh_nrf5340_cpuapp_ns_defconfig
```kconfig
# Copyright (c) 2024 Classified Cycling BV
# SPDX-License-Identifier: Apache-2.0

# Enable MPU
CONFIG_ARM_MPU=y

# Enable hardware stack protection
CONFIG_HW_STACK_PROTECTION=y

# Enable TrustZone-M
CONFIG_ARM_TRUSTZONE_M=y

# This Board implies building Non-Secure firmware
CONFIG_TRUSTED_EXECUTION_NONSECURE=y

# Enable GPIO
CONFIG_GPIO=y
CONFIG_GPIO_INIT_PRIORITY=40

# Enable REGULATOR
CONFIG_REGULATOR=y
CONFIG_REGULATOR_FIXED_INIT_PRIORITY=45

# Enable QSPI NOR
CONFIG_NORDIC_QSPI_NOR=y
CONFIG_NORDIC_QSPI_NOR_INIT_PRIORITY=48
CONFIG_NORDIC_QSPI_NOR_FLASH_LAYOUT_PAGE_SIZE=4096
CONFIG_NORDIC_QSPI_NOR_STACK_WRITE_BUFFER_SIZE=16

# Required by QSPI
CONFIG_MULTITHREADING=y
```

## boards/classified/cc_msh_v2/Kconfig.cc_msh_v2
```kconfig
# Copyright (c) 2025 Classified Cycling BV
# SPDX-License-Identifier: Apache-2.0

config BOARD_CC_MSH_V2
	select SOC_NRF54L15_CPUAPP if BOARD_CC_MSH_V2_NRF54L15_CPUAPP
	select SOC_NRF54L15_CPUAPP if BOARD_CC_MSH_V2_NRF54L15_CPUAPP_NS
	select SOC_NRF54L15_CPUFLPR if BOARD_CC_MSH_V2_NRF54L15_CPUFLPR
	select SOC_NRF54L15_CPUFLPR if BOARD_CC_MSH_V2_NRF54L15_CPUFLPR_XIP
```

## boards/classified/cc_msh_v2/Kconfig.defconfig
```kconfig
# Copyright (c) 2025 Classified Cycling BV
# SPDX-License-Identifier: Apache-2.0

if BOARD_CC_MSH_V2_NRF54L15_CPUAPP

config BT_CTLR
	default BT

config ROM_START_OFFSET
	default 0 if PARTITION_MANAGER_ENABLED
	default 0x800 if BOOTLOADER_MCUBOOT

endif # BOARD_CC_MSH_V2_NRF54L15_CPUAPP

if BOARD_CC_MSH_V2_NRF54L15_CPUAPP_NS

config BT_CTLR
	default BT

# By default, if we build for a Non-Secure version of the board,
# enable building with TF-M as the Secure Execution Environment.
config BUILD_WITH_TFM
	default y

# By default, if we build with TF-M, instruct build system to
# flash the combined TF-M (Secure) & Zephyr (Non Secure) image
config TFM_FLASH_MERGED_BINARY
	default y
	depends on BUILD_WITH_TFM

endif # BOARD_CC_MSH_V2_NRF54L15_CPUAPP_NS
```

## boards/classified/cc_msh_v2/board.yml
```yaml
board:
  name: cc_msh_v2
  full_name: Classified Cycling Multispeed Hub v2
  vendor: classified
  socs:
  - name: nrf54l15
    variants:
    - name: xip
      cpucluster: cpuflpr
    - name: ns
      cpucluster: cpuapp
```

## boards/classified/cc_msh_v2/cc_msh_v2_nrf54l15_cpuapp_ns_defconfig
```kconfig
# Copyright (c) 2025 Classified Cycling BV
# SPDX-License-Identifier: Apache-2.0

# Enable UART driver
CONFIG_SERIAL=y

# Enable console
CONFIG_CONSOLE=y
CONFIG_UART_CONSOLE=y

# Enable GPIO
CONFIG_GPIO=y

# Enable REGULATOR
CONFIG_REGULATOR=y

# Enable MPU
CONFIG_ARM_MPU=y

# Enable hardware stack protection
CONFIG_HW_STACK_PROTECTION=y

# MPU-based null-pointer dereferencing detection cannot
# be applied as the (0x0 - 0x400) is unmapped for this target.
CONFIG_NULL_POINTER_EXCEPTION_DETECTION_NONE=y

# Enable TrustZone-M
CONFIG_ARM_TRUSTZONE_M=y

# This Board implies building Non-Secure firmware
CONFIG_TRUSTED_EXECUTION_NONSECURE=y

# Don't enable the cache in the non-secure image as it is a
# secure-only peripheral on 54l
CONFIG_CACHE_MANAGEMENT=n
CONFIG_EXTERNAL_CACHE=n

# Start SYSCOUNTER on driver init
CONFIG_NRF_GRTC_START_SYSCOUNTER=y
```
